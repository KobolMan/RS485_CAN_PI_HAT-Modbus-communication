/**
******************************************************************************
* @file    : crc.c
* @author  : Respeke
* @website : www.etdev.net
* @brief   : Modbus crc16 and STM32 hardware crc32 algorithm.
*/

/* Includes ------------------------------------------------------------------*/
#include "modbus_crc.h"

/* Private variables ---------------------------------------------------------*/
const uint16_t polynom16 = 0xA001;
const uint32_t polynom32 = 0x04c11db7;

/* Table of CRC values for highиCorder byte */
const uint8_t CRCTableHigh[] = {
  0x00, 0xC1, 0x81, 0x40, 0x01, 0xC0, 0x80, 0x41, 0x01, 0xC0, 0x80, 0x41, 0x00, 0xC1, 0x81,
  0x40, 0x01, 0xC0, 0x80, 0x41, 0x00, 0xC1, 0x81, 0x40, 0x00, 0xC1, 0x81, 0x40, 0x01, 0xC0,
  0x80, 0x41, 0x01, 0xC0, 0x80, 0x41, 0x00, 0xC1, 0x81, 0x40, 0x00, 0xC1, 0x81, 0x40, 0x01,
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  0x00, 0xC1, 0x81, 0x40, 0x01, 0xC0, 0x80, 0x41, 0x01, 0xC0, 0x80, 0x41, 0x00, 0xC1, 0x81,
  0x40
};

/* Table of CRC values for lowиCorder byte */
const uint8_t CRCTableLow[] = {
  0x00, 0xC0, 0xC1, 0x01, 0xC3, 0x03, 0x02, 0xC2, 0xC6, 0x06, 0x07, 0xC7, 0x05, 0xC5, 0xC4,
  0x04, 0xCC, 0x0C, 0x0D, 0xCD, 0x0F, 0xCF, 0xCE, 0x0E, 0x0A, 0xCA, 0xCB, 0x0B, 0xC9, 0x09,
  0x08, 0xC8, 0xD8, 0x18, 0x19, 0xD9, 0x1B, 0xDB, 0xDA, 0x1A, 0x1E, 0xDE, 0xDF, 0x1F, 0xDD,
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  0x44, 0x84, 0x85, 0x45, 0x87, 0x47, 0x46, 0x86, 0x82, 0x42, 0x43, 0x83, 0x41, 0x81, 0x80,
  0x40
};

const uint16_t CRCTableAbs[] = { 
  0x0000, 0xCC01, 0xD801, 0x1400, 0xF001, 0x3C00, 0x2800, 0xE401, 
  0xA001, 0x6C00, 0x7800, 0xB401, 0x5000, 0x9C01, 0x8801, 0x4400 
};

uint16_t ModbusCRC_CheckTable(uint8_t *ptr, uint16_t len)
{
  uint8_t crcHigh = 0xff;
  uint8_t crcLow = 0xff; 
  uint16_t index;
  while (len--) 
  {
    index = crcLow ^ *ptr++; 
    crcLow = crcHigh ^ CRCTableHigh[index];
    crcHigh = CRCTableLow[index];
  }
  return (crcHigh << 8 | crcLow);
}

uint16_t ModbusCRC_CheckTableAbs(uint8_t *ptr, uint16_t len) 
{
  uint16_t crc = 0xffff; 
  uint16_t i;
  uint8_t ch;
  
  for (i = 0; i < len; i++) 
  {
    ch = *ptr++;
    crc = CRCTableAbs[(ch ^ crc) & 15] ^ (crc >> 4);
    crc = CRCTableAbs[((ch >> 4) ^ crc) & 15] ^ (crc >> 4);
  } 
  
  return crc;
}

uint16_t ModbusCRC_Calc(uint8_t *ptr, uint16_t len)
{
  uint8_t i;
  uint16_t crc = 0xffff;
  
  if (len == 0) {
    len = 1;
  }
  while (len--) {
    crc ^= *ptr;
    for (i = 0; i<8; i++)
    {
      if (crc & 1) {
        crc >>= 1;
        crc ^= polynom16;
      }
      else {
        crc >>= 1;
      }
    }
    ptr++;
  }
  return(crc);
}



uint32_t STM32CRC_IntCalc(uint32_t *ptr, int len)
{
  uint32_t xbit, data;
  uint32_t crc = 0xffffffff;    // init value
  
  while (len--) {
    xbit = 0x80000000;
    
    data = *ptr++;
    for (int bits = 0; bits < 32; bits++) 
    {
      if (crc & 0x80000000) {
        crc <<= 1;
        crc ^= polynom32;
      }
      else
        crc <<= 1;
      
      if (data & xbit)
        crc ^= polynom32;
      
      xbit >>= 1;
    }
  }
  return crc;
}

uint32_t STM32CRC_CharCalc(uint8_t *p, uint32_t len) 
{  
  // fast bit by bit algorithm without augmented zero bytes.
  // does not use lookup table.
  
  uint32_t i, j, c, bit;
  uint32_t crchighbit = 0x80000000;
  uint32_t crc = 0xffffffff;
  
  for (i = 0; i < len; i++)
  {
    c = (uint32_t)*p++;
    
    for (j = 0x80; j; j >>= 1) {
      
      bit = crc & crchighbit;
      crc <<= 1;
      
      if (c & j) 
        bit ^= crchighbit;
      
      if (bit) 
        crc ^= polynom32;
    }
  }
  
  return(crc);
}
